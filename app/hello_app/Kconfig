## board/contest_board/Kconfig
```kconfig
#
# Contest 2026 team 162 board
#
# Copyright (C) 2026 Yang Hongbo <yang.hongbo@iotpi.xyz>
# SPDX-License-Identifier: Apache-2.0
#

if ARCH_BOARD_CONTEST2026_000_BOARD

config ARCH_BOARD_CONTEST2026_000_BOARD_TAG
	string "Board tag"
	default "contest2026_000_board"

endif
```
